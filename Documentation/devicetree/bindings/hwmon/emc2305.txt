## Documentation/devicetree/bindings/hwmon/emc2305.txt
```
EMC2305 (I2C)

This device is a RPM-based PWM Fan Speed Controller for up to 5 fans.

Required properties:
- compatible: "smsc,emc2305"
- reg: I2C bus address of the device
- #pwm-cells: should be 2. See pwm.yaml in this directory for a description of
  the cells format.

Example:

i2c@0 {
	#address-cells = <1>;
	#size-cells = <0>;
	emc2305@2c {
		compatible = "smsc,emc2305";
		reg = <0x2c>;
	        #pwm-cells = <2>;
	};
};
```

## arch/e2k/Kconfig.debug
```kconfig
# SPDX-License-Identifier: GPL-2.0
# Copyright (c) 2023 MCST

config TRACE_IRQFLAGS_SUPPORT
        def_bool y

menu "e2k architecture debugging"

config MARK_KERNEL_PAGE_TABLES
	bool "Mark kernel page tables with separate bit"
	depends on CPU_ISET >= 6
	default DEBUG_VM
	help
	  Marks kernel page tables entries (both intermediate and last level)
	  with 45th bit (<=v5) or 55th bit (>=v6) which is unused by hardware.
	  Useful for debugging with DTLB microprogram's help.

	  If DEBUG_VM is set, this will also be used to catch (valid & !present)
	  kernel mappings.  Such mappings are forbidden because semi-speculative
	  load will cause a needless spurious interrupt if happens to hit them.

config NESTED_PAGE_FAULT_INJECTION
	bool "Inject nested page faults when handling trap cellar"
	depends on DEBUG_FS
	default n
	help
	  Makes do_page_fault() return success without doing anything with
	  some probability. This way recovery operation will fail, and the
	  code path in nested page fault handler will be tested.
	  Use `echo 1 > <debugfs>/nested_page_fault_injection` to enable
	  or set CONFIG_NESTED_PAGE_FAULT_INJECTION_ENABLED_DEFAULT.

config NESTED_PAGE_FAULT_INJECTION_ENABLED_DEFAULT
	bool "Enabled nested page faults injection by default"
	depends on NESTED_PAGE_FAULT_INJECTION
	default y
	help
	  Enable nested page faults injection by default?

config SEMI_SPEC_LOADS_INJECTION
	bool "Inject semi-speculative loads in kernel"
	depends on SEMI_SPECULATIVE_KERNEL
	default n
	help
	  Inject semi-speculative loads in various places in kernel to try
	  to trigger problems with semi-spec. mode support in page tables
	  (i.e. valid bit is set or cleared as needed in kernel PTEs).

config DEBUG_LCC_VOLATILE_ATOMIC
	bool "Mark GNU asm with atomic operations as volatile"
	default n

config DEBUG_IRQ
	bool "Check of IRQ enabled/disabled using both PSR & UPSR"
	default n

config DEBUG_STACK_USAGE
	bool "Stack utilization instrumentation"
	depends on DEBUG_KERNEL
	help
	  Enables the display of the minimum amount of free stack which each
	  task has ever had available in the sysrq-T and sysrq-P debug output.

	  This option will slow down process creation somewhat.

config E2K_STACKS_TRACER
	bool "Trace kernel stacks usage"
	default n
	depends on !STACK_TRACER
	select FUNCTION_TRACER
	select STACKTRACE
	select KALLSYMS
	help
	  This special tracer records the maximum stack footprint of the
	  kernel and displays it in /sys/kernel/debug/tracing/stack_trace.
	  You can use 'stack_trace_filter' file to select which functions
	  to check the stacks on.

	  This tracer works by hooking into every function call that the
	  kernel executes, and keeping a maximum stack depth value and
	  stack-trace saved.  If this is configured with DYNAMIC_FTRACE
	  then it will not have any overhead while the stack tracer
	  is disabled.

	  To enable the stack tracer on bootup, pass in 'stacktrace'
	  on the kernel command line.

	  The stack tracer can also be enabled or disabled via the
	  sysctl kernel.stack_tracer_enabled

	  Pass stacktrace_filter= to the kernel command line to set
	  specific functions to check the stacks on.

	  Say N if unsure.

source	"arch/l/Kconfig.debug"

endmenu
```
