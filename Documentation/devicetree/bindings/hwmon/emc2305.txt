## arch/e2k/crypto/Kconfig
```kconfig
# SPDX-License-Identifier: GPL-2.0
# Copyright (c) 2026 MCST

menu "Accelerated Cryptographic Algorithms for CPU (e2k)"

config CRYPTO_CHACHA_E2K
	tristate "Ciphers: ChaCha20"
	depends on E2K && CPU_ISET_MAX >= 3
	default m
	select CRYPTO_SKCIPHER
	select CRYPTO_LIB_CHACHA_GENERIC
	select CRYPTO_ARCH_HAVE_LIB_CHACHA
	help
	  Length-preserving cipher: ChaCha stream ciphers (RFC 7539)

	  Architecture: E2K using: 64 and 128 bits SIMD operations

	  It is available as of E2Kv3+.

config CRYPTO_CRC32C_E2K
	tristate "CRC32c (CLMUL)"
	depends on E2K && CPU_ISET_MAX >= 6
	default y
	select CRYPTO_HASH
	help
	  CRC32c CRC algorithm with the iSCSI polynomial (RFC 3385 and RFC 3720)

	  Used by btrfs, ext4, jbd2, NVMeoF/TCP, and iSCSI.

	  Architecture: E2Kv6+ using:
	    - CLMULH/CLMULL (64 bit carry-less multiplication)

endmenu
```

## arch/l/Kconfig
```kconfig
# SPDX-License-Identifier: GPL-2.0
# Copyright (c) 2023 MCST

#
# For a description of the syntax of this configuration file,
# see Documentation/kbuild/kconfig-language.txt.
#
config IOMMU_HELPER
        bool
        default y
	select GENERIC_ALLOCATOR

menu "Elbrus Architecture Linux Kernel Configuration"

config EPIC
	def_bool E90S || (E2K && (!E2K_MACHINE || CPU_ISET_MIN >= 6 || KVM_HOST_MODE))
	help
	  Elbrus Programmable Interrupt Controller supports multiprocessor
	  systems with up to 1024 cores and uses 10 bit vectors for
	  masked interrupts.
	  Controller implements hardware support for interrupt virtualization.
	  Consists of CEPIC (per core), PREPIC (per processor) and IOEPIC.
	  Say 'Y' to enable EPIC support in kernel

config EIOHUB_PCI
	def_bool  EPIC
	help
	  Support plugging EIOHub/IOEPIC PCI card into an older APIC-based system.
	  Boot should not pass IOEPIC info and IRQs (no boot modification required)

config IOHUB2_PCI
	def_bool  EPIC
	help
	  Support plugging IOHub2/IOAPIC PCI card into a EPIC-based system.
	  Boot should pass both IOEPIC and IOAPIC info and IRQs in MP-table.

menu "Boot/prom console support"

config L_EARLY_PRINTK
	def_bool n

config SERIAL_PRINTK
	bool "dump_printk() support"
	depends on E2K || E90S
	default y
	select L_EARLY_PRINTK
	help
	  dump_printk() outputs directly to serial port bypassing all
	  buffers and locks. It is useful for hardware debugging.

	  Only two devices are supported currently: ns16550 (== 8550)
	  and l_zilog (== am85c30).

	  On simulator dump_printk() also outputs to LMS console.

	  Kernel parameter "boot_printk_all" is added. If set, dump_print()
	  will be used everywhere instead of printk().

config NVRAM_PANIC
	bool "save panic output to nvram"
	depends on E2K || E90S
	default y
	help
	   panic output is saved into nvram. It can be extracted from
	   nvram after reboot using /proc/sys/kernel/nvram_panic

config SERIAL_AM85C30_CONSOLE
	def_bool  SERIAL_PRINTK && (!E2K || SERIAL_AM85C30_BOOT_CONSOLE)
	help
	  Init-time serial console on Am85c30 zilog and compatible devices

config EARLY_DUMP_CONSOLE
	def_bool  L_EARLY_PRINTK
	help
	  Early serial console based on Am85c30/8250 or hvc

endmenu # "Boot/prom console support"

config MCST
	bool "MCST additions"
	default y

config MCST_4RT
	bool "MCST additions for RT without rt-patch"
	default y
	help
	  Say Y here to enable support RT additions
	  such as rts_mode, rts_mask, EL_RT_CPU, EL_SET_MLOCK_CONTROL.
	  It helps to get hard rt properties for OS with
	  as well as without Ingo Molner's rt-patch.

config CLKR_CLOCKSOURCE
	def_bool E90S

config CLKR_SYNCHRONIZATION_WARNING
	bool
	depends on CLKR_CLOCKSOURCE && SMP
	default n
	help
	  Set to Y to enable warnings about CLKR registers synchronization
	  across several CPUs.

config CLKR_OFFSET
	bool
	depends on CLKR_CLOCKSOURCE && SMP
	default y
	help
	  Set to Y when different cpus' clock registers have the same
	  frequency but different initial values. Then per-cpu offset
	  will be added to each cpu's register value.


config L_LOCAL_APIC
	def_bool y
	depends on E2K || E90S

config L_IO_APIC
	def_bool y
	depends on E2K || E90S

config L_PCI_QUIRKS
	def_bool PCI_MSI
	depends on L_IO_APIC
	select PCI_QUIRKS

config L_PMC
	tristate "Elbrus-1C+ Power Management Controller"
	depends on E2K
	select CPU_FREQ if !MCST_RT
	select PM_OPP
	default m
	help
	  Power Management Controller for Elbrus-1C+

config S2_PMC
	bool "R2000 Power Management Controller (S2 PMC)"
	depends on E90S
	select CPU_IDLE  if !MCST_RT
	select CPU_FREQ  if !MCST_RT
	default y # we need s2_get_freq_mult() for r2000
	help
	 Power Management Controller (PMC) for MCST R2000 (E90S/SPARC v9) CPU
menu "Device Tree"
config OF
	bool "Device Tree support"
	default y
	select DTC if E2K
	select OF_EARLY_FLATTREE
	select TIMER_OF
	select PROC_DEVICETREE
	select OF_DYNAMIC
	select OF_OVERLAY
	select OF_DMA_DEFAULT_COHERENT
	help
	   If you say yes to this option, support will be included for
	   Device Tree data structure. The tree will be displaed in
	   /proc/device-tree.
config DTB_L_TEST
	bool "Use kernel's built-in dtb blob"
	default n
	depends on OF
	help
	   If you say yes to this option, kernel will use built-in dtb blob
	   instead of trying to get it from bootloader. Built-in blob is an
	   array defined in arch/l/kernel/devtree.c.

endmenu
endmenu # "Elbrus Architecture Linux Kernel Configuration"
```

## arch/l/pci/Kconfig
```kconfig
# SPDX-License-Identifier: GPL-2.0
# Copyright (c) 2023 MCST

#
# For a description of the syntax of this configuration file,
# see Documentation/kbuild/kconfig-language.txt.
#

menu "Elbrus chipset PCI support"

config PCI_ELBRUS
       def_bool (E2K || E90S) && PCI
       help
         Elbrus PCI controller designed for machines based on both
	 microprocessors arch: e2k and e90s

config IOHUB_DOMAINS
	def_bool PCI_ELBRUS && NUMA && (E2K || E90S)
	select PCI_DOMAINS
	help
          Each node on Elbrus NUMA based machine has a few IO links
          so system can have multiple IOHUBs to support PCI domains
	  If say Y then PCI controllers will be scaned on each online
	  node
	  If say N then only one root IOHUB will be enabled on node 0

endmenu # "Elbrus chipset PCI support"
```

## drivers/dca/Kconfig
```kconfig
# SPDX-License-Identifier: GPL-2.0-only
#
# DCA server configuration
#

config DCA
	tristate

config E2K_DCA
	bool "E2K DCA provider support in intel network cards"
	select DCA
	depends on E2K_E48C
	help
	  Add a E2K DCA provider to support a TPH mode in intel network cards.
```

## drivers/mcst/Kconfig
```kconfig
# SPDX-License-Identifier: GPL-2.0
# Copyright (c) 2023 MCST

menu "Elbrus MCST Device Drivers"

config GPIO_MPV
	tristate "MCST GPIO-MPV Controller Support"
	depends on E2K || E90S
	default y
	help
	GPIO-MPV base driver

config MCST_LTD
	tristate "MCST LTD (Log Transmit Device) Support"
	depends on E2K || E90S
	select REGMAP_MMIO
	default m
	help
	Support for MCST PMC logger

config I2C_SPI_RESET_CONTROLLER
	bool "MCST I2C SPI Controller Support"
	depends on PCI && (E2K || E90S)
	default y
	help
	  Support for MCST I2C SPI Controller

config L_I2C_CONTROLLER
	tristate "Elbrus I2C Controller"
	depends on I2C && I2C_SPI_RESET_CONTROLLER
	default y
	help
	  If you say yes to this option, support will be
	  included for the Elbrus I2C controller that is
	  part of Elbrus IOHUB.

config L_SPI_CONTROLLER
	tristate "Elbrus SPI controller"
	depends on SPI && I2C_SPI_RESET_CONTROLLER
	default y
	help
	  If you say yes to this option, support will be
	  included for the Elbrus SPI controller that is
	  part of Elbrus IOHUB.

config I2C_SPI_IRQ
	bool
	depends on L_SPI_CONTROLLER || L_I2C_CONTROLLER
	default n

config L_MTD_SPI_NOR
	bool "Elbrus MTD support"
	depends on L_SPI_CONTROLLER && MTD_SPI_NOR && MTD_CMDLINE_PARTS && MTD_BLOCK && ROMFS_FS
	default n
	help
	  If you say yes to this option, embedded flash (S25FL064A or similar) driver will
	  be switched from SPIDEV to SPI-NOR.
	  Both can be used by flashrom userspace tool, but SPI-NOR/MTD also requires mtd-utils
	  package. Selecting SPIDEV by default

config IPE2ST_POWER
	tristate "Elbrus IPE2-ST Power Source"
	depends on E2K && L_I2C_CONTROLLER && GPIO_PCA953X && ISL22317
	default m
	help
	   If you say yes to this option, support will be included for the
	   Elbrus IPE2-ST Power Source. IPE2-ST uses GPIO_PCA953x and ISL22317
	   by modprobing them from /etc.

config ACPI_L_SPMC
	bool "Processor-8 SPMC Controller (SCI, PM Timer, sleep states)"
	depends on E2K || E90S
	default y
	help
	   If you say yes to this option, support will be
	   included for the Processor-8 SPMC Controller (SCI, PM Timer,
	   sleep states) that is part of IOHUB-2.


config IOHUB_GPIO
	tristate "IOHUB Gpiolib"
	depends on GPIOLIB && (E2K || E90S)
	default m
	help
	   Gpiolib implementation for Elbrus IOHUB.

config DRM_MGA2
	tristate "MGA 2 and higher video adapter"
	depends on PCI && DRM && (CPU_E1CP || CPU_E2C3 || CPU_E8V7 || E90S)
	default m
	select FB_CFB_FILLRECT
	select FB_CFB_COPYAREA
	select FB_CFB_IMAGEBLIT
	select VIDEOMODE_HELPERS
	select DRM_KMS_HELPER
	select DRM_KMS_FB_HELPER
	select DRM_DW_HDMI
	select DRM_DW_HDMI_CEC
	select DRM_I2C_SIL164
	select DRM_PANEL_LVDS
	select BACKLIGHT_PWM
	select DRM_SIMPLE_BRIDGE
	select DRM_SII902X
	select DRM_TI_SN65DSI86
	select DRM_PANEL_SIMPLE
	select DRM_DISPLAY_CONNECTOR
	select DRM_MIPI_DSI
	select DRM_DW_MIPI_DSI
	select I2C_GPIO
	select REGULATOR_LP872X
	select DRM_GEM_DMA_HELPER
	select REGULATOR_FIXED_VOLTAGE
	select DRM_ITE_IT66121

config E2C3_DEVFREQ
	tristate "E2C3 devfreq provider driver for graphic devices"
	depends on E2K && PM_DEVFREQ && CPU_E2C3
	default m
	help
		"E2C3 devfreq provider driver for graphic devices"

config MPV
	tristate "MPV driver"
	depends on MCST && PCI

config MMRSE
	tristate "MMRSE PCI driver"
	depends on PCI
	default m
	help
	  New driver for MMRM module


config WD
	bool "WD driver"
	depends on E2K
	help
	  System work(watchdog) control manager.
	  /dev/watchdog major 10 minor 130

config HANTRODEC
	tristate "Google hantrodec VP9 driver"
	default m
	depends on E2K && PCI && CPU_E2C3
	help
	  Google VP9 driver.

config MCST_VC9000D
	tristate "Verisilicon hantrodec VC9000D driver"
	default m
	depends on E2K && PCI && (CPU_E2C3 || CPU_E8V7)
	help
	  Verisilicon VC9000D video decoder technological driver.

config MCST_HANTRO_DRIVER
	tristate "Verisilicon Hantro DRM driver for VA-API"
	default m
	depends on E2K && PCI && (CPU_E2C3 || CPU_E8V7)
	help
	  Verisilicon Hantro DRM driver for VA-API (for VC9000D video decoder in e8v7 SoC).

config BIGE
	tristate "Google bige VP9 encoder driver"
	default m
	depends on E2K && PCI && (CPU_E2C3 || CPU_E8V7)
	select UIO
	help
	  Google VP9 encoder driver.

config E8CPCS
	tristate "E8C Power Control System (PCS) hwmon driver"
	depends on E2K && (CPU_E8C || CPU_E8C2)
	default m

config DDRMEM
	tristate "Memory Test driver"
	depends on E2K && (CPU_E8C2 || CPU_E2C3 || CPU_E16C)
	default m

config IPLINKS
	tristate "Iplinks Test driver"
	depends on (E2K && (CPU_E2S || CPU_E8C || CPU_E8C2 || CPU_E12C || CPU_E16C)) || E90S
	default m

config PCSM
	tristate "Power Control System (PCS) for e8c* and e2c3 system's"
	depends on E2K
	default m
	help
	  Needed for power management system (based on e1c+ or other)

config IMGTEC
	tristate "Imagination codec driver"
	depends on E2K && CPU_E2C3
	default m
	select BUS_MASTERING
	select VXD_FPGA
	help
	  Imagination codec driver.

config BUS_MASTERING
        def_bool y
        depends on IMGTEC

config VXD_FPGA
        def_bool y
        depends on IMGTEC

source "drivers/mcst/smi/Kconfig"

config SMI_PWM
	tristate "Silicon Motion pulse-width modulation (PWM) driver"
        depends on PWM
	default m

config SMI_GPIO
	tristate "Silicon Motion GPIO driver"
        depends on GPIOLIB
	select GPIOLIB_IRQCHIP
	default m

config SENSORS_EMC2305
	tristate "SMSC EMC2305"
	depends on I2C
	help
	  If you say yes here you get support for the SMSC EMC2305/EMC2303
	  fan controller chips.

	  This driver can also be built as a module.  If so, the module
	  will be called emc2305.

config HW_CHECK
	tristate "Hardware checker (ipcc, mem, bitrate, pins) for engineers"
	depends on (E2K || E90S)
	default m
	help
	  Module for checking memory bitrate, ipcc bitrate,
	  pins configuration, multiproccesor links info and memory links info.

config FATAL_TEMP
	tristate "Setting fatal temperature"
	depends on E2K
	default m
	help
	  Module for setting fatal temperature

config L_I2S
	tristate "MCST I2S controller"
	help
		Say Y here to include support for MCST I2S controller.

		To compile this driver as a module, choose M here: the module
		will be called l-i2s.

config DS125DF111
	tristate "DS125DF111 - Multi-Protocol 2-Channel Retimer"
	depends on E2K && CPU_E16C
	default m
	help
		Say Y here to include support for DS125DF111 Retimer.

		To compile this driver as a module, choose M here: the module
		will be called ds125df111.

config I2C_V7
	tristate "MCST I2C V7 master controller"
	depends on E2K
	default m
	help
	  Module for MCST I2C master controller for V7 architecture.

endmenu

config MCST_QDMA_PF
	tristate "Xilinx qdma-pf driver"
	depends on E2K && PCI
	default n
	help
	 taken from https://github.com/Xilinx/dma_ip_drivers/DDMA/linux-kernel/driver and adopted 

config MCST_QDMA_VF
	tristate "Xilinx qdma-vf driver"
	depends on E2K && PCI
	default n
	help
	 taken from https://github.com/Xilinx/dma_ip_drivers/DDMA/linux-kernel/driver and adopted
```

## drivers/mcst/gpu-viv-e8v7/Kconfig
```kconfig
menu "MCST Vivante GPU support (galcore v7.0.0.36)"
	depends on DRM

config MCST_GPU_VIV_E8V7
	tristate "Vivante GPU support for E8V7 SoC (galcore v7.0.0.36)"
	depends on ARCH_FORCE_MAX_ORDER > 15 && E2K && (CPU_E2C3 || CPU_E8V7)
	select DRM_VM
	default m
	help
         Say Y to get the GPU driver support.

config MCST_GPU_VIV_E8V7_FPGA_PROTO
  bool "Build special version for FPGA prototype"
  depends on MCST_GPU_VIV_E8V7
  default y
  help
    Increases waiting timeouts and some code behavior.
    Choose this option to debugging only.
    Please rebuild userland code with this option, also.

endmenu
```

## drivers/net/ethernet/mcst/Kconfig
```kconfig
# SPDX-License-Identifier: GPL-2.0
# Copyright (c) 2023 MCST

#
# Sunlance device configuration
#

config SBUS_SUNLANCE
	tristate "Sun LANCE support for SBUS"
	depends on SBUS
	select CRC32
	help
	  This driver supports the "le" interface present on all 32-bit Sparc
	  systems, on some older Ultra systems and as an Sbus option.  These
	  cards are based on the AMD Lance chipset, which is better known
	  via the NE2100 cards.

	  To compile this driver as a module, choose M here: the module
	  will be called sbus-sunlance.

config PCI_SUNLANCE
	tristate "Pci version Sun LANCE support"
	depends on PCI
	select CRC32
	help
	  To compile this driver as a module, choose M here: the module
	  will be called pci-sunlance.

config MCST_PCC
	tristate "PCC controller (MCST) support"
	depends on PCI
	default n
	help
	  Driver for ethernet over PCI on MGA3D. PCC is the second
	  function of MGA3D.

	  Select y if you have this device on board.

config ETH1000
	tristate "Elbrus Gigabit Ethernet support"
	depends on PCI
	select CRC32
	select MII

config MXGBE
	tristate "Elbrus 10-Gigabit Ethernet support"
	depends on PCI && EPIC && ELDWCXPCS
	default n

config MXGBE_DCA
	bool "Direct Cache Access (DCA) Support"
	default y
	depends on MXGBE && E2K_E48C
	help
	   Say Y here if you want to use Direct Cache Access (DCA) in the
	   MXGBE driver.  DCA is a method for warming the CPU cache before data
	   is used, with the intent of lessening the impact of cache misses.

config MGB
	tristate "Elbrus 1/2.5 Gigabit Ethernet card (KPI3)"
	depends on PCI && EPIC && ELDWCXPCS
	default n

config MGB_RT
	tristate "KPI3 Gigabit Ethernet card as p-2-p "
	depends on MCST_RT && PCI && EPIC && ELDWCXPCS
	default m
```
