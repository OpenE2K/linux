/*
 * SPDX-License-Identifier: GPL-2.0
 * Copyright (c) 2023 MCST
 */

#define NODES 1
#define CELLS 2
#define NODE 0

#define E2C3

/ {
	#address-cells = <CELLS>;
	#size-cells = <CELLS>;

#include <e2k/e2k-v6.dtsi>
#include <e2k/e2k-v6-uncore.dtsi>
#include <e2k/eioh.dtsi>

#undef NODE

};
