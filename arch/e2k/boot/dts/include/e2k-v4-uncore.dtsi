/*
 * SPDX-License-Identifier: GPL-2.0
 * Copyright (c) 2025 MCST
 */

#include "e2k-v3-uncore.dtsi"

#if CELLS == 2
	L_PCS: pcs@NODE,cc4 {
		compatible = "mcst,l_pcs";
		reg = <NSR_ADDR(00cc4) 0 0x14>;
		numa-node-id = <NODE>;
		nonposted-mmio;
		#thermal-sensor-cells = <1>;
	};
#endif
