#include <dt-bindings/interrupt-controller/irq.h>
#include "apic-vectors.h"

#ifndef NODE
# error NODE undefined
#endif

#define __LVT(_n) lvt ## _n
#define _LVT(_n) __LVT(_n)
#define LVT _LVT(NODE)


#define __SIC(_n) sic ## _n
#define _SIC(_n) __SIC(_n)
#define SIC _SIC(NODE)

	LVT: LVT {
		compatible = "mcst,epic-linp";
		interrupt-parent = <&lpic>;
		interrupt-controller;
		numa-node-id = <NODE>;
		#interrupt-cells = <3>;
	};
	SIC {
		compatible = "mcst,sic";
		/* reg = <0x1 0x10000000 0 0x100000>; not used */
		interrupt-parent = <&LVT>;
		numa-node-id = <NODE>;
		interrupts = <LINP2_INTERRUPT_VECTOR 2 0>;
	};
