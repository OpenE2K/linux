/*
 * SPDX-License-Identifier: GPL-2.0
 * Copyright (c) 2023 MCST
 */

#ifndef NODES
# define NODES 1
#endif
#define CELLS 2

#define E48C

/ {
	#address-cells = <CELLS>;
	#size-cells = <CELLS>;

#define NODE 0
#include <e2k/e2k-v7.dtsi>

# ifdef NODE0_DMN_A_OK
#  define DMN_1_STS "ok"
# endif
# ifdef NODE0_DMN_B_OK
#  define DMN_2_STS "ok"
# endif
# ifdef NODE0_DMN_C_OK
#  define DMN_3_STS "ok"
# endif
# ifdef NODE0_DMN_D_OK
#  define DMN_4_STS "ok"
# endif
#include <e2k/e2k-v7-uncore.dtsi>
#include <e2k/eioh2.dtsi>
#undef NODE

#if NODES > 1
# define NODE 1
# ifdef NODE1_DMN_A_OK
#  define DMN_1_STS "ok"
# endif
# ifdef NODE1_DMN_B_OK
#  define DMN_2_STS "ok"
# endif
# ifdef NODE1_DMN_C_OK
#  define DMN_3_STS "ok"
# endif
# ifdef NODE1_DMN_D_OK
#  define DMN_4_STS "ok"
# endif
# include <e2k/e2k-v7-uncore.dtsi>
# include <e2k/eioh2.dtsi>
# undef NODE
#endif

#if NODES > 2
# define NODE 2
# ifdef NODE2_DMN_A_OK
#  define DMN_1_STS "ok"
# endif
# ifdef NODE2_DMN_B_OK
#  define DMN_2_STS "ok"
# endif
# ifdef NODE2_DMN_C_OK
#  define DMN_3_STS "ok"
# endif
# ifdef NODE2_DMN_D_OK
#  define DMN_4_STS "ok"
# endif
# include <e2k/e2k-v7-uncore.dtsi>
# include <e2k/eioh2.dtsi>
# undef NODE
#endif

#if NODES > 3
# define NODE 3
# ifdef NODE3_DMN_A_OK
#  define DMN_1_STS "ok"
# endif
# ifdef NODE3_DMN_B_OK
#  define DMN_2_STS "ok"
# endif
# ifdef NODE3_DMN_C_OK
#  define DMN_3_STS "ok"
# endif
# ifdef NODE3_DMN_D_OK
#  define DMN_4_STS "ok"
# endif
# include <e2k/e2k-v7-uncore.dtsi>
# include <e2k/eioh2.dtsi>
# undef NODE
#endif

};
