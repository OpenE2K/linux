/*
 * SPDX-License-Identifier: GPL-2.0
 * Copyright (c) 2025 MCST
 */

#include <dt-bindings/interrupt-controller/irq.h>

#include "e2k-macro.dtsi"
#include "epic.dtsi"
#include "cpufreq.dtsi"

	esclk_timer {
		compatible = "mcst,esclk-timer";
	};