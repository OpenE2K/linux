#include <dt-bindings/interrupt-controller/irq.h>
#include "epic-vectors.h"

#ifndef NODE
# error NODE undefined
#endif
#ifndef CELLS
# error CELLS undefined
#endif

#if CELLS == 1
# define REG reg32
#else
# define REG reg
#endif

#ifndef PIC
# define __PIC(_n) pic ## _n
# define _PIC(_n) __PIC(_n)
# define PIC _PIC
#endif

#ifndef LVT
# define __LVT(_n) lvt ## _n
# define _LVT(_n) __LVT(_n)
# define LVT _LVT(NODE)
#endif

# define __IOMMU(_n) iommu ## _n
# define _IOMMU(_n) __IOMMU(_n)
# define IOMMU _IOMMU(NODE)

# define __PCICFG_ADDRL(_a, _n) 0x2 ## _n ## _a
# define _PCICFG_ADDRL(_a, _n) __PCICFG_ADDRL(_a, _n)
# define PCICFG_ADDRL(_a) _PCICFG_ADDRL(_a, NODE)

# define __PCICFG_ADDR(_a, _n) 0x2 0x0 ## _n ## _a
# define _PCICFG_ADDR(_a, _n) __PCICFG_ADDR(_a, _n)
# define PCICFG_ADDR(_a) _PCICFG_ADDR(_a, NODE)

# define __NSR_ADDR(_a, _n) 0x1 0x10 ## _n ## _a
# define _NSR_ADDR(_a, _n) __NSR_ADDR(_a, _n)
# define NSR_ADDR(_a) _NSR_ADDR(_a, NODE)


	PIC: pic@NODE {
		compatible = "mcst,ioepic";

		regbar-and-size64 = /bits/ 64 <PCICFG_ADDRL(001101c) 0x100000>;

		interrupt-parent = <&lpic>;
		interrupt-controller;
		numa-node-id = <NODE>;
		#interrupt-cells = <2>;
	};

	IOMMU: iommu@NODE {
		compatible = "mcst,e2k-iommu";
		REG = <NSR_ADDR(00380) 0 0x80>,
			<NSR_ADDR(05080) 0 0x380>; /* for embedded devices */
		#iommu-cells = <1>;
		numa-node-id = <NODE>;
		interrupt-parent = <&LVT>;
		interrupts = <LINP1_INTERRUPT_VECTOR 1 0>;
	};

	pci@NODE {
		compatible = "mcst,l-pci";
		REG = <PCICFG_ADDR(0000000) 0 0x10000000>, /*E2S_PCICFG_AREA_PHYS_BASE*/
			<NSR_ADDR(00050) 0 4>, /*SIC_rt_pciio0*/
			<NSR_ADDR(00040) 0 4>, /*SIC_rt_pcim0*/
			<NSR_ADDR(00070) 0 4>, /*SIC_rt_pcimp_b0*/
			<NSR_ADDR(00080) 0 4>; /*SIC_rt_pcimp_e0*/
		reg-names = "cfg", "io", "mem", "pref-bgn", "pref-end";

		linux,pci-domain = <NODE>;
		numa-node-id = <NODE>;
		msi-parent = <&lmsi>;
		/*rid-base,iommu,iommu-base,length*/
		iommu-map = <0x0 &IOMMU 0x0 0x10000>;
		/* 1:1 translation, max size (48-bit) of e2k address space */
		ranges = <  0 0 0 /* child address */
#if CELLS == 1
			      0 /* parent address */
#elif CELLS == 2
			      0 0 /* parent address */
#else
# error CELLS not supported
#endif
			0x10000 00000000>;/* child size */
		interrupt-parent = <&PIC>;
		interrupts = <22 IRQ_TYPE_LEVEL_HIGH>; /*SERR (all devices)*/

		#address-cells = <3>;
		#size-cells = <2>;
	};

