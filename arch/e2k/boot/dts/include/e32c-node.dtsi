#include "e2c3-node.dtsi"


# define __NSR_ADDR(_a, _n) 0x1 0x10 ## _n ## _a
# define _NSR_ADDR(_a, _n) __NSR_ADDR(_a, _n)
# define NSR_ADDR(_a) _NSR_ADDR(_a, NODE)

	ltd@NODE {
		compatible = "mcst,ltd-tty";
		reg = <NSR_ADDR(00900) 0 0x28>;
		numa-node-id = <NODE>;
		interrupt-parent = <&LVT>;
		interrupts = <LINP6_INTERRUPT_VECTOR 6 0>;
	};

#undef __NSR_ADDR
#undef _NSR_ADDR
#undef NSR_ADDR
