/*
 * SPDX-License-Identifier: GPL-2.0
 * Copyright (c) 2023 MCST
 */

#include <dt-bindings/interrupt-controller/irq.h>

#include "e2k-macro.dtsi"
#include "epic.dtsi"
#include "cpufreq.dtsi"
#include "sclkr.dtsi"
