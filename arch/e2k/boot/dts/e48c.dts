/*
 * SPDX-License-Identifier: GPL-2.0
 * Copyright (c) 2023 MCST
 */

/dts-v1/;

#define NODES 1

#ifndef NODES
# error NODES undefined
#endif

#define NODE 0

#ifndef CELLS
#define CELLS 2
#endif

/ {
	version = "2.0_2025-11-07";
	model = "Elbrus-generic";
	compatible = "mcst,e48c-generic";

	#address-cells = <CELLS>;
	#size-cells = <CELLS>;


#include "include/e2k-v7.dtsi"
#include "include/e2k-v7-uncore.dtsi"
#include "include/eioh2.dtsi"
#undef NODE

};
