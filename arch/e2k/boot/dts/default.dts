/*
 * SPDX-License-Identifier: GPL-2.0
 * Copyright (c) 2023 MCST
 */

/dts-v1/;

/ {
	version = "1.0_2026-06-18";
	model = "Elbrus-generic";
	compatible = "mcst,elbrus-generic";

	#address-cells = <2>;
	#size-cells = <2>;
};
