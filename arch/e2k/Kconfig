## drivers/cpuidle/Kconfig.e2k
```kconfig
#
# E2K CPU Idle drivers
#

config E2K_CPUIDLE
	bool "CPU Idle driver for e2k machines"
	depends on CPU_IDLE && E2K && !KVM_GUEST_KERNEL
	default y
	help
	  This adds the CPU Idle driver for e2k machines
```

## drivers/cpuidle/Kconfig.e90s
```kconfig
 # SPDX-License-Identifier: GPL-2.0
 # Copyright (c) 2023 MCST
 
#
# E2K CPU Idle drivers
#

config E90S_CPUIDLE
	tristate "CPU Idle Driver for E90S machines (r2000)"
	depends on E90S
	default m
	help
	  CPU Idle driver for E90S machines (r2000).
```

## drivers/gpu/drm/mcst/Kconfig
```kconfig
config DRM_MCST
	tristate "MCST MGAM/MGA3D DRM driver"
	depends on DRM && PCI
	select DRM_TTM
	select FB_DEFERRED_IO
	select FB_SYS_COPYAREA
	select FB_SYS_FILLRECT
	select FB_SYS_IMAGEBLIT
	select DRM_KMS_HELPER
	help
	 Say yes for experimental MCST MGAM/MGA3D driver

config DRM_MCST_DEBUG
        bool "Build in MCST's debugfs support"
        depends on DRM_MCST && DEBUG_FS
        default n
        help
          Say Y here if you want MCST DRM to output debugging information
          via debugfs.
```

## drivers/mcst/gpu-imgtec.r5824814/Kconfig
```kconfig
menu "MCST support of Imagination`s GPU (Rogue_DDK_Linux_WS_REL_1.13@5824814)"
	depends on DRM && E2K && MCST_GPU_IMGTEC_R5824814

config MCST_GPU_IMGTEC_GPUVIRT
	bool "Enable GPU virtualization support"
        depends on VIRTUALIZATION
	default n
	---help---
         Enable GPU virtualization support.

config MCST_GPU_IMGTEC_GPUVIRT_GUESTDRV
	bool "Enable guest driver build."
	depends on MCST_GPU_IMGTEC_GPUVIRT
	default n
	---help---
	 Enable guest driver build.

config MCST_GPU_IMGTEC_GPUVIRT_NUM_OSID
	int "Number of firmware supported OSIDs"
	depends on MCST_GPU_IMGTEC_GPUVIRT
	default 2
	---help---
	 Number of firmware supported OSIDs

config MCST_GPU_IMGTEC_PDUMP
	bool "Enable PDUMP support in E2C3 GPU graphics driver"
	default n
        help
          Choose this option to enable PDUMP on E2C3 GPU

          (use for debugging only).

config MCST_GPU_IMGTEC_DEBUG
	bool "Build debug version of E2C3 GPU graphics driver"
	default n
	help
	  Choose this option to debugging only

	  Please rebuild userland code and firmware with debug, also.

config MCST_GPU_IMGTEC_CONTIGUOUS_FW
	bool "Allocate contiguous physical memory for GPU FW heap"
	default y
	help
	  For virtualization builds, FW heaps (for host and all guests) should normally be allocated
	  as any other DMA buffer, using dma_alloc_coherent. This currently does not work on e2c3
	  prototype, so we enable this workaround to alloc FW heaps contiguously in physical memory

endmenu
```

## drivers/mcst/gpu-imgtec/Kconfig
```kconfig
menu "MCST support of Imagination`s GPU (Rogue_DDK_Linux_WS_REL_1.13@5824814)"
	depends on DRM && E2K

config MCST_GPU_IMGTEC
	tristate "MCST support Imagination`s GPU support for E2C3 SoC (Rogue_DDK_Linux_WS_REL_1.13@5824814)"
	select DRM_VM
	default m
	---help---
         Say Y to get the GPU driver support.

config MCST_GPU_IMGTEC_GPUVIRT
	bool "Enable GPU virtualization support"
        depends on MCST_GPU_IMGTEC && VIRTUALIZATION
	default n
	---help---
         Enable GPU virtualization support.

config MCST_GPU_IMGTEC_GPUVIRT_GUESTDRV
	bool "Enable guest driver build."
	depends on MCST_GPU_IMGTEC_GPUVIRT
	default n
	---help---
	 Enable guest driver build.

config MCST_GPU_IMGTEC_GPUVIRT_NUM_OSID
	int "Number of firmware supported OSIDs"
	depends on MCST_GPU_IMGTEC_GPUVIRT
	default 2
	---help---
	 Number of firmware supported OSIDs

config MCST_GPU_IMGTEC_PDUMP
	bool "Enable PDUMP support in E2C3 GPU graphics driver"
	depends on MCST_GPU_IMGTEC
	default n
	help
	  Choose this option to enable PDUMP on E2C3 GPU (for debugging only).

config MCST_GPU_IMGTEC_DEBUG
	bool "Build debug version of E2C3 GPU graphics driver"
	depends on MCST_GPU_IMGTEC
	default n
	help
	  Choose this option to debugging only (rebuild userland code and firmware with debug, also).

config MCST_GPU_IMGTEC_CONTIGUOUS_FW
	bool "Allocate contiguous physical memory for GPU FW heap"
	depends on MCST_GPU_IMGTEC
	default y
	help
	  For virtualization builds, FW heaps (for host and all guests) should normally be allocated
	  as any other DMA buffer, using dma_alloc_coherent. This currently does not work on e2c3
	  prototype, so we enable this workaround to alloc FW heaps contiguously in physical memory

endmenu
```

## drivers/mcst/gpu-viv/Kconfig
```kconfig
menu "MCST Vivante GPU support (galcore v6.2.4p3)"
	depends on DRM_VIVANTE

config MCST_GPU_VIV
	tristate "MCST Vivante GPU support (galcore v6.2.4p3)"
	depends on FORCE_MAX_ZONEORDER > 15
	select DRM_VM
	default m
	---help---
         Say Y to get the GPU driver support.

endmenu
```

## drivers/net/can/mcst/Kconfig
```kconfig
 # SPDX-License-Identifier: GPL-2.0
 # Copyright (c) 2023 MCST
 
#
# Mcst CAN device configuration
#

config CAN_ELCAN
	tristate "MCST PCI Bus based ELCAN driver"
	depends on PCI
	default n
	help
	  This driver adds support for the ELCAN/CAN2 connected
	  to the PCI bus.
```

## drivers/net/ethercat/Kconfig
```kconfig
#
# IgH EtherCAT Master configuration
#

menuconfig ETHERCAT
	bool "EtherCAT support"
	depends on ETHERNET
	default y
	---help---
	  This section contains EtherCAT Master support.

if ETHERCAT
config EC_MASTER
	tristate "IgH EtherCAT master driver support"
	default y
	---help---
	  Device-independent part of The IgH EtherCAT Master.
	  Say Y to include support for IgH EtherCAT Master.

	  To compile this driver as a module, choose M here: the module
	  will be called ec_master.

config EC_MASTER_DEBUG_IF
	bool "Debug for IgH EtherCAT master driver"
	depends on EC_MASTER
	default y
	---help---
	  Debugging facilities for IgH EtherCAT Master.

config EC_MASTER_EOE
	bool "Ethernet over Ethercat for IgH EtherCAT master support"
	depends on EC_MASTER
	default y
	---help---
	  Ethernet over Ethercat (EOE) for IgH EtherCAT Master.
endif # ETHERCAT
```

## drivers/net/pcs/Kconfig
```kconfig
# SPDX-License-Identifier: GPL-2.0-only
#
# PCS Layer Configuration
#

menu "PCS device drivers"

source "drivers/net/pcs/mcst/Kconfig"

endmenu
```

## drivers/net/pcs/mcst/Kconfig
```kconfig
#
# Mcst PHY device configuration
#

config ELDWCXPCS
	tristate "MCST PCS PHY"
	depends on PCI
	---help---
	  DesignWare Cores Ethernet PCS PHY (DWC_xpcs)
```

## drivers/video/Kconfig
```kconfig
# SPDX-License-Identifier: GPL-2.0-only
#
# Video configuration
#

menu "Graphics support"

if HAS_IOMEM

config HAVE_FB_ATMEL
	bool

source "drivers/char/agp/Kconfig"

source "drivers/gpu/vga/Kconfig"

source "drivers/gpu/host1x/Kconfig"
source "drivers/gpu/ipu-v3/Kconfig"

source "drivers/gpu/drm/Kconfig"

menu "Frame buffer Devices"
source "drivers/video/fbdev/Kconfig"
endmenu

source "drivers/video/backlight/Kconfig"

config VGASTATE
       tristate
       default n

config VIDEOMODE_HELPERS
	bool

config HDMI
	bool

config FB_MGAM83
	tristate
	depends on FB
	select FB_CFB_FILLRECT
	select FB_CFB_COPYAREA
	select FB_CFB_IMAGEBLIT
	select FB_SOFT_CURSOR
	default n

config PCI_FB_MGAM83
	tristate "PCI MGAM83 Frame buffer driver"
	depends on PCI && FB
	select FB_MGAM83
	default y

config MGA_HWCOPYAREA
	bool "PCI - Harware accelerator for \"fb_copyarea\" enabling"
	depends on PCI_FB_MGAM83
	default y

config MGA_HWIMAGEBLIT
	bool "Harware accelerator for \"fb_imageblit\" enabling"
	depends on PCI_FB_MGAM83
	default y

config SBUS_FB_MGAM83
	tristate "SBUS MGAM83 Frame buffer driver"
	depends on SBUS && FB
	select FB_MGAM83
	default y

config SBUS_MGA_HWCOPYAREA
	bool "SBUS - Harware accelerator for \"fb_copyarea\" enabling"
	depends on SBUS_FB_MGAM83 
	default y

config FB_MGA3D
	tristate "MGA3D framebuffer driver"
	depends on PCI && FB
	default m

endif # HAS_IOMEM

if VT
	source "drivers/video/console/Kconfig"
endif

if FB || SGI_NEWPORT_CONSOLE
	source "drivers/video/logo/Kconfig"

endif


endmenu
```

## kernel/Kconfig.hz
```kconfig
# SPDX-License-Identifier: GPL-2.0-only
#
# Timer Interrupt Frequency Configuration
#

choice
	prompt "Timer frequency"
	default HZ_250
	help
	 Allows the configuration of the timer frequency. It is customary
	 to have the timer interrupt run at 1000 Hz but 100 Hz may be more
	 beneficial for servers and NUMA systems that do not need to have
	 a fast response for user interaction and that may experience bus
	 contention and cacheline bounces as a result of timer interrupts.
	 Note that the timer interrupt occurs on each processor in an SMP
	 environment leading to NR_CPUS * HZ number of timer interrupts
	 per second.


	config HZ_100
		bool "100 HZ"
	help
	  100 Hz is a typical choice for servers, SMP and NUMA systems
	  with lots of processors that may show reduced performance if
	  too many timer interrupts are occurring.

	config HZ_250
		bool "250 HZ"
	help
	 250 Hz is a good compromise choice allowing server performance
	 while also showing good interactive responsiveness even
	 on SMP and NUMA systems. If you are going to be using NTSC video
	 or multimedia, selected 300Hz instead.

	config HZ_300
		bool "300 HZ"
	help
	 300 Hz is a good compromise choice allowing server performance
	 while also showing good interactive responsiveness even
	 on SMP and NUMA systems and exactly dividing by both PAL and
	 NTSC frame rates for video and multimedia work.

	config HZ_1000
		bool "1000 HZ"
	help
	 1000 Hz is the preferred choice for desktop systems and other
	 systems requiring fast interactive responses to events.

	config HZ_10
		bool "10 HZ"
	depends on MCST && E2K	# only under CONFIG_MCST && CONFIG_E2K
	help
	 10 Hz is a typical choice for simulator e2k arch.
	 Such a low HZ due to the low frequency of simulated hardware.

	config HZ_20
		bool "20 HZ"
	depends on MCST		# only under CONFIG_MCST
	help
	 20 Hz is a typical choice for simulator e2k/x86 arch.
	 It is the minimum HZ value for x86 to do not cause an overflow
	 of 16 bits 'PIT_LATCH' (PIT timer counter).
	 Such a low HZ due to the low frequency of simulated hardware.

endchoice

config HZ
	int
	default 100 if HZ_100
	default 250 if HZ_250
	default 300 if HZ_300
	default 1000 if HZ_1000
	default 10 if HZ_10		# only under CONFIG_MCST && CONFIG_E2K
	default 20 if HZ_20		# only under CONFIG_MCST

config SCHED_HRTICK
	def_bool HIGH_RES_TIMERS
```

## kernel/Kconfig.preempt
```kconfig
config PREEMPT
	bool
	select PREEMPT_COUNT

config PREEMPT_RT_BASE
	bool
	select PREEMPT

config HAVE_PREEMPT_LAZY
	bool

config PREEMPT_LAZY
	def_bool y if HAVE_PREEMPT_LAZY && PREEMPT_RT_FULL

choice
	prompt "Preemption Model"
	default PREEMPT_NONE

config PREEMPT_NONE
	bool "No Forced Preemption (Server)"
	help
	  This is the traditional Linux preemption model, geared towards
	  throughput. It will still provide good latencies most of the
	  time, but there are no guarantees and occasional longer delays
	  are possible.

	  Select this option if you are building a kernel for a server or
	  scientific/computation system, or if you want to maximize the
	  raw processing power of the kernel, irrespective of scheduling
	  latencies.

config PREEMPT_VOLUNTARY
	bool "Voluntary Kernel Preemption (Desktop)"
	help
	  This option reduces the latency of the kernel by adding more
	  "explicit preemption points" to the kernel code. These new
	  preemption points have been selected to reduce the maximum
	  latency of rescheduling, providing faster application reactions,
	  at the cost of slightly lower throughput.

	  This allows reaction to interactive events by allowing a
	  low priority process to voluntarily preempt itself even if it
	  is in kernel mode executing a system call. This allows
	  applications to run more 'smoothly' even when the system is
	  under load.

	  Select this if you are building a kernel for a desktop system.

config PREEMPT__LL
	bool "Preemptible Kernel (Low-Latency Desktop)"
	select PREEMPT
	select UNINLINE_SPIN_UNLOCK if !ARCH_INLINE_SPIN_UNLOCK
	help
	  This option reduces the latency of the kernel by making
	  all kernel code (that is not executing in a critical section)
	  preemptible.  This allows reaction to interactive events by
	  permitting a low priority process to be preempted involuntarily
	  even if it is in kernel mode executing a system call and would
	  otherwise not be about to reach a natural preemption point.
	  This allows applications to run more 'smoothly' even when the
	  system is under load, at the cost of slightly lower throughput
	  and a slight runtime overhead to kernel code.

	  Select this if you are building a kernel for a desktop or
	  embedded system with latency requirements in the milliseconds
	  range.

config PREEMPT_RTB
	bool "Preemptible Kernel (Basic RT)"
	select PREEMPT_RT_BASE
	help
	  This option is basically the same as (Low-Latency Desktop) but
	  enables changes which are preliminary for the full preemptible
	  RT kernel.

config PREEMPT_RT_FULL
	bool "Fully Preemptible Kernel (RT)"
	depends on IRQ_FORCED_THREADING
	select PREEMPT_RT_BASE
	select PREEMPT_RCU
	help
	  All and everything

endchoice

config MCST_RT
	bool "MCST enhancement of PREEMPT_RT_FULL"
	default y
	depends on PREEMPT_RT_FULL
	help
	   Possibility to turn off some fair opportunuties
	   for all tasks to decrease latency for RT tasks

config USB_IRQ_ON_THREAD
	bool "USB irq implemented as threaded irq "
	depends on MCST_RT
	default y
	help
	  USB interrupt handler just find out interrupt, all other work
	  is done on threadfn thread. It is useful if USB shares irq with
	  important rt device.
	  Say Y if you want that usb interrupts executed on kernel thread.
	  Otherwise say N

config MCST_RT_SMP
        bool
        depends on SMP

config MCST_RT_GRQ
        bool "MCST RT: Global Runqueue Additions"
        depends on  MCST_RT && SMP && !CGROUPS && !GROUP_SCHED && !CPUSETS
        default y
        select MCST_RT_SMP

config MCST_RT_NUMA
        bool "MCST RT NUMA additions"
        depends on  MCST_RT && NUMA && !CGROUPS && !GROUP_SCHED && !CPUSETS
        default y
        select MCST_RT_SMP

config NETDEV_THREADS
	bool "Each net dev has personal softirq threads"
	depends on MCST_RT
	default y
	help
	  net devices don't use SOFTIRQ stuff (NET_TX_SOFTIRQ and
	  NET_RX_SOFTIRQ not used). Each net device has it's own
	  threads pair - one for receiving and one for transmitting. It's
	  possible to bind these threads to CPU and assign priority
	  for each thread separately.

config PREEMPT_COUNT
       bool
```

## ltt/Kconfig
```kconfig
menuconfig LTT
	boolean "Linux Trace Toolkit Next Generation (LTTng)"
	depends on MODULES
	depends on KALLSYMS
	depends on HIGH_RES_TIMERS
	depends on TRACEPOINTS
	default n
	help
	  It is possible for the kernel to log important events to a trace
	  facility. Doing so enables the use of the generated traces in order
	  to reconstruct the dynamic behavior of the kernel, and hence the
	  whole system.

	  The tracing process contains 4 parts :
	      1) The logging of events by key parts of the kernel.
	      2) The tracer that keeps the events in a data buffer (uses
	         relay).
	      3) A trace daemon that interacts with the tracer and is
	         notified every time there is a certain quantity of data to
	         read from the tracer.
	      4) A trace event data decoder that reads the accumulated data
	         and formats it in a human-readable format.

	  If you say Y, the first component will be built into the kernel.

	  For more information on kernel tracing, lttctl, lttd or lttv,
	  please check the following address :
	       http://ltt.polymtl.ca
```

## security/altha/Kconfig
```kconfig
config SECURITY_ALTHA
	bool "AltHa security module"
	depends on SECURITY
	default n
	help
	  Some hardening options:
	    * ignore SUID on binaries (with exceptions possible);
	    * prevent running selected script interprers in interactive move;
	    * WxorX for filesystems (with exceptions possible);

	  If you are unsure how to answer this question, answer N.
```
