## arch/e2k/sec_space/Kconfig
```kconfig
config SECONDARY_SPACE_SUPPORT
	bool "Support Secondary Space feature in OS"
	default y
	help
	  Select 'y' if you are going to run native Linux-x86 code under
	  this OS.

config MLT_STORAGE
	def_bool SECONDARY_SPACE_SUPPORT

source "arch/e2k/sec_space/rtc_procfs/Kconfig"
```

## arch/e2k/sec_space/rtc_procfs/Kconfig
```kconfig
 # SPDX-License-Identifier: GPL-2.0
 # Copyright (c) 2023 MCST
 
config RTC_PROC_FS
	tristate "procfs support for binary compiler"
	depends on PROC_FS && !KVM_GUEST_KERNEL
	default y
	help
	  Special filesystem for binary compiler (rtc) that helps with
	  hiding compiler-specific data from files in /proc when they
	  are opened by recompiled application.  Can be done in userspace
	  but kernel-side implementation is faster.
```

## arch/l/Kconfig.debug
```kconfig
menu "Elbrus architecture kernel hacking"

config BOOT_TRACE
	bool "Profile boot process"
	depends on ARCH_BOOT_TRACE_POSSIBLE
	default n
	---help---
	  If this option is enabled, some time statictics will be collected
	  during boot. They are available in the proc filesystem in
	  /proc/loadtime_kernel and /proc/loadtime.

config BOOT_TRACE_THRESHOLD
	int "Threshold in milliseconds"
	depends on BOOT_TRACE
	default 100
	---help---
	  Minimum delta between events for them to be printed.

endmenu
```
